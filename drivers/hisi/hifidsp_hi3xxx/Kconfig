## drivers/hisi/hifidsp_hi3xxx/Kconfig
```kconfig
menu "Hifimisc driver serve HIFI dsp"

config SND_HIFI_LPP_HI3XXX
     bool "hifi low power play device support"
     default n
     help
          hifi lpp device provide service for HIFI and AP, in case of HIFI ultra-low power audio play.
config SND_HIFI_LOAD_HI3XXX
     bool "hifi low power play device loae section in kernel"
     default n
     help
          load hifi image in hifi driver.
config SND_HIFI_SEC_LOAD_HI3XXX
     bool "hifi low power play device support"
     default n
     help
          hifi lpp device provide service for HIFI and AP, in case of HIFI ultra-low power audio play.
	  load hifi image in security os

endmenu
```

## drivers/hisi/mailbox/hi3xxx_mailbox/Kconfig
```kconfig
comment "HiIPCV230 ipc MailBox driver"
config HI3XXX_MAILBOX
	bool "HiIPCV230 ipc MailBox driver"
	default n
	help
	  HiIPCV230 ipc MailBox driver

comment "HiIPCV230 ipc mailboxes debugfs user"
config HI3XXX_MAILBOX_DEBUGFS
	bool "HiIPCV230 ipc mailboxes debugfs user"
	depends on HI3XXX_MAILBOX && DEBUG_FS
	default n
	help
	  HiIPCV230 ipc mailboxes debugfs user

comment "HiIPCV230 ipc MailBox driver performance debug"
config HI3XXX_MAILBOX_PERFORMANCE_DEBUG
	bool "HiIPCV230 ipc MailBox driver performance debug"
	depends on HI3XXX_MAILBOX
	default n
	help
	  Print tts of sending task, if config is set y

comment "HISI K3V3 kernel API about remote processor communication"
config HI3XXX_RPROC
	bool "HISI K3V3 ipc kernel API"
	default n
	help
	  Packet complex mailbox interfaces & provide simple kernel API

comment "HISI K3V3 rproc kernel API debugfs"
config HI3XXX_RPROC_DEBUGFS
	bool "HISI K3V3 rproc kernel API debugfs"
	depends on HI3XXX_RPROC && DEBUG_FS
	default n
	help
	  debug for hi3xxx_rproc
```

## drivers/hisi/mntn/Kconfig
```kconfig
config HISILICON_PLATFORM_MAINTAIN
	bool "Hisilicon platform maintain module support"
	default n
	help
	  Say yes here to support the hisilicon platform maintain module 
```

## drivers/hisi/modem_hi6xxx/Kconfig
```kconfig
config HI6XXX_MODEM_MULTICORE
	bool "Kirin620 modem part for multicore support"
	select HI6XXX_MAILBOX_MULTICORE
	default n
	help
	  Say yes here to support the Kirin620 modem part for multicore lib
config HI6XXX_MODEM_PLATFORM
        bool "Hisilicon Kirin620 modem platform support"
        default n
        help
          Say yes here to support the hisilicon Kirin620 modem platform

if HI6XXX_MODEM_PLATFORM

source "drivers/hisi/modem_hi6xxx/interface/Kconfig"
source "drivers/hisi/modem_hi6xxx/ipf/Kconfig"
source "drivers/hisi/modem_hi6xxx/rfile/Kconfig"
source "drivers/hisi/modem_hi6xxx/timer/Kconfig"
source "drivers/hisi/modem_hi6xxx/om/Kconfig"

endif          #HI6XXX_MODEM_PLATFORM
```

## drivers/hisi/noc/Kconfig
```kconfig
config HISILICON_PLATFORM_NOC
	bool "Support HiSilicon NOC"
	default n
	help
	  This driver supports HiSilicon HiXXX NOC,
	  including hisilicon noc driver.

config HI6XXX_NOC
	bool "Support HiSilicon Hi3XXX NOC"
	depends on ARCH_HI6XXX
	default n
	help
	  This driver supports HiSilicon Hi6XXX NOC,
	  including hisilicon noc driver.

config HI6XXX_NOC_ERR_PROBE
	depends on HI6XXX_NOC
	bool "Support HiSilicon Hi6XXX NOC Error Probe"
	default n
	help
	  NoC Error Probe driver

config HI3XXX_NOC
	bool "Support HiSilicon Hi3XXX NOC"
	depends on ARCH_HI3XXX
	default n
	help
	  This driver supports HiSilicon Hi3XXX NOC,
	  including hisilicon noc driver.
 
config HI3XXX_NOC_ERR_PROBE
	depends on HI3XXX_NOC
	bool "Support HiSilicon Hi3XXX NOC Error Probe"
	default n
	help
	  NoC Error Probe driver

config CONFIG_HI3XXX_NOC_TIMEOUT
	depends on HI3XXX_NOC
	bool "Support HiSilicon Hi3XXX NOC timeout irq"
	default n
	help
	   NoC irq timeout driver
```

## drivers/hisi/pm/Kconfig
```kconfig
config HISILICON_PLATFORM_POWER_CONTROL
	bool "Support HiSilicon Hi6XXX Power Control"
	depends on ARCH_HI6XXX
	default n
	help
	  This driver supports HiSilicon HiXXX Power Control,
	  including hisilicon hi6xxx power control driver, etc.
```

## drivers/huawei/Kconfig
```kconfig
config HUAWEI_PLATFORM
	bool "Huawei platform support"
	default n
	help
	  Say yes here to support the huawei platform


if HUAWEI_PLATFORM
menu "huawei linux device driver support package"

source "drivers/huawei/nfc/Kconfig"
source "drivers/huawei/irda/Kconfig"
source "drivers/huawei/chipverification/Kconfig"
source "drivers/huawei/hw_kstate/Kconfig"
source "drivers/huawei/ddrinfo/Kconfig"
endmenu
endif # HUAWEI_PLATFORM
```

## drivers/huawei_platform/audio/Kconfig
```kconfig
source "drivers/huawei_platform/audio/max98925/Kconfig"
source "drivers/huawei_platform/audio/speakerID/Kconfig"
```

## drivers/huawei_platform/camera_legacy/Kconfig
```kconfig
if HUAWEI_PLATFORM

source "drivers/huawei_platform/camera_legacy/hi6220/Kconfig"

endif # HUAWEI_PLATFORM
```

## drivers/power/huawei/Kconfig
```kconfig
config BATTERY_HI6XXX_SMARTSTAR
	bool "hi6xxx smartstar"
	default n
config BATTERY_HISI_COUL
        bool "hisi coul"
        default n
config BQ_BCI_BATTERY
        bool "bq bci battery"
        default n
config BQ2419X_CHARGER
        bool "hi6xxx bq2419x charger"
        default n        
config HI6521_CHARGER
        bool "hi6xxx hi6521 charger"
        default n
config CHARGER_TYPE_RECHECK
        bool "hi6xxx charger type recheck"
        default n
```
