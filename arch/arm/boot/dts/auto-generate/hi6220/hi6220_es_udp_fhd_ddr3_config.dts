/*
 *  Copyright (C) 2014 Hisilicon Ltd.
 *  Author: Bintian Wang <bintian.wang@huawei.com>
 *
 *  This program is free software; you can redistribute it and/or modify
 *  it under the terms of the GNU General Public License version 2 as
 *  publishhed by the Free Software Foundation.
 */

/dts-v1/;
/memreserve/ 0x07000000 0x00400000;
/include/ "hi6220_es_udp_ddr3_config.dtsi"
/include/ "hi6220_es_udp_fhd_ddr3_pin.dtsi"
/include/ "hi6220_es_udp_fhd_ddr3_gpio_logic.dtsi"
/include/ "hi6220_es_udp_fhd_ddr3_pmic.dtsi"
/include/ "hi6220_es_udp_fhd_ddr3_charger.dtsi"
/ {
	hisi,boardid = <0 0 3 3>;
	hisi,boardname = "hi6220_es_udp_fhd_ddr3";

    boardinfo{
	factory_product_name = "UDP";
	normal_product_name = "UDP";
	};
};
