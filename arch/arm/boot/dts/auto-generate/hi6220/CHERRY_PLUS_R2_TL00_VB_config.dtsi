/*
 *  Copyright (C) 2014 Hisilicon Ltd.
 *  Author: Bintian Wang <bintian.wang@huawei.com>
 *
 *  This program is free software; you can redistribute it and/or modify
 *  it under the terms of the GNU General Public License version 2 as
 *  publishhed by the Free Software Foundation.
 */

/include/ "CHERRY_PLUS_R2_UL00_VB_config.dtsi"
/include/ "CHERRY_PLUS_R2_TL00_VB_pin.dtsi"
/include/ "CHERRY_PLUS_R2_TL00_VB_gpio_logic.dtsi"
/include/ "CHERRY_PLUS_R2_TL00_VB_pmic.dtsi"
/include/ "CHERRY_PLUS_R2_TL00_VB_charger.dtsi"
/ {
	model = "Hisilicon Hi6210 Development Board";
	compatible = "hisilicon,hi6210";
	hisi,boardid = <0 7 0 1>;
	hisi,boardname = "CHERRY_PLUS_R2_TL00_VB";
        hisi,modem_id = <0x3DD51500>;
	hisi,product_name = "CHERRY_PLUS_TL00";
	
	boardinfo{
	factory_product_name = "HL1CHRPLS";
	normal_product_name = "Che2-TL00";
	};
	
	bcm_wifi {
		wifi_nvram_name = "/vendor/firmware/nvram_CHERRY_PLUS_TL00.txt";
		status = "ok";
	};
};
