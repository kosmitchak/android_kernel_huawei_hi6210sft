/ {
	touchscreen {
		compatible = "huawei,touchscreen";
		bus_type = "i2c";
		bus_id = <1>;
		product = "hi6210_sft";
		has_virtualkey = <1>;
		support_chip_name = "synaptics";
		synaptics: touchscreen@70 {
			compatible = "synaptics";
			/*0-S3207, 1-S3350, 2-3320*/
			ic_type = <0>;
			x_max = <2200>;
			y_max = <3800>;
			x_max_mt = <720>;
			y_max_mt = <1280>;
			vci_gpio_type = <1>;
			vci_regulator_type = <1>;
			vddio_gpio_type = <1>;
			vddio_regulator_type = <0>;
			vci_ctrl_gpio = <&gpio2 4 0>;
			vddio_ctrl_gpio = <&gpio2 4 0>;
			slave_address = <0x70>;
			pinctrl-names = "default", "idle";
			pinctrl-0 = <&ISP_STROBE0_pmx_func
			&ISP_STROBE0_cfg_func
			&GPIO_1_0_cfg_func>;
			pinctrl-1 = <&ISP_STROBE0_pmx_idle
			&ISP_STROBE0_cfg_idle
			&GPIO_1_0_cfg_idle>;

			synaptics-vdd-supply = <&schg_ldo1>;
			synaptics-io-supply;
			reset_gpio = <&gpio10 4 0>;
			attn_gpio = <&gpio1 0 0>;
			irq_config = <3>;
			algo_id = <1>;
		};
	};
};
