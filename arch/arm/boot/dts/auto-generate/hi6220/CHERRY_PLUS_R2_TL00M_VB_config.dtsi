/*
 * Hisilicon Ltd.
 *
 * A15x4 A7x4
 *
 * It is only a demo for hisilicon hi3630 board. You show change the
 * address of each node according to datasheet.
 */

/include/ "CHERRY_PLUS_R2_TL00_VB_config.dtsi"
/include/ "CHERRY_PLUS_R2_TL00M_VB_pin.dtsi"
/include/ "CHERRY_PLUS_R2_TL00M_VB_gpio_logic.dtsi"
/include/ "CHERRY_PLUS_R2_TL00M_VB_pmic.dtsi"
/include/ "CHERRY_PLUS_R2_TL00M_VB_charger.dtsi"
/ {
	hisi,boardid = <0 7 2 0>;
	hisi,boardname = "CHERRY_PLUS_R2_TL00M_VB";
	hisi,modem_id = <0x3DD51500>;
	hisi,product_name = "CHERRY_PLUS_TL00M";

	boardinfo{
	factory_product_name = "HL1CHRPLS";
	normal_product_name = "Che2-TL00M";
	};
};

