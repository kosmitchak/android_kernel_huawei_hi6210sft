/*
 *  Copyright (C) 2014 Hisilicon Ltd.
 *  Author: Bintian Wang <bintian.wang@huawei.com>
 *
 *  This program is free software; you can redistribute it and/or modify
 *  it under the terms of the GNU General Public License version 2 as
 *  publishhed by the Free Software Foundation.
 */

/include/ "hi6220_sft_mali400_config.dtsi"
/include/ "hi6220_sft_mali450_gpio_logic.dtsi"
///include/ "hi6220_sft_mali450_pin.dtsi"
/ {
	hisi,boardid = <1 0 0 1>;
	hisi,boardname = "hi6220_sft_mali450";

    boardinfo{
	factory_product_name = "UDP";
	normal_product_name = "UDP";
	};
    
	mali:mali@f4080000 {
		compatible = "hisilicon,mali_gpu";
		reg = <0xf4080000 0x9100>;
		/*reg = <0xf4081000 0x200>,<0xf4080000 0x100>,<0xf4083000 0x100>,<0xf4088000 0x1100>,<0xf4084000 0x100>;*/
		interrupts = <0 110 4>,<0 110 4>,<0 110 4>,<0 110 4>;
		clocks = <&clk_g3d>,<&pclk_g3d>;
		clock-names  = "clk_g3d","pclk_g3d";
		G3D_PD_VDD-supply  = <&mtcmos5>;
		status = "ok";
		mali_def_freq = <50>;
		pclk_freq = <40>;
		dfs_steps = <2>;
		dfs_lockprf = <1>;
		dfs_limit_max_prf = <1>;
		dfs_profile_num = <2>;
		dfs_profiles = <40 1 0>,<50 3 1>;
		mali_type = <0>;/*Mali400MP1*/
	};

	/*video&camera common config*/
	video_config: video_config {
		support_isp = <0>; /*0---not support isp; 1---support isp*/
		support_vpu = <0>; /*0---not support vpu; 1---support vpu*/
		support_jpu = <0>; /*0---not support jpu; 1---support jpu*/
	};
};
