/*
 *  Copyright (C) 2014 Hisilicon Ltd.
 *  Author: Bintian Wang <bintian.wang@huawei.com>
 *
 *  This program is free software; you can redistribute it and/or modify
 *  it under the terms of the GNU General Public License version 2 as
 *  publishhed by the Free Software Foundation.
 */

/include/ "CHERRY_PLUS_R2_HI1101_TL00_config.dtsi"
/include/ "CHERRY_PLUS_R2_HI1101_TL00_VC_pin.dtsi"
/include/ "CHERRY_PLUS_R2_HI1101_TL00_VC_gpio_logic.dtsi"
/include/ "CHERRY_PLUS_R2_HI1101_TL00_VC_charger.dtsi"
/include/ "CHERRY_PLUS_R2_HI1101_TL00_VC_pmic.dtsi"
/ {
    hisi,boardid = <0 7 4 2>;
    hisi,boardname = "CHERRY_PLUS_R2_HI1101_TL00_VC";
    hisi,modem_id = <0x3DD52100>;
};
