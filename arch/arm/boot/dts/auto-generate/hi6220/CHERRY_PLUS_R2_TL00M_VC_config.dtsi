/*
 * Hisilicon Ltd.
 *
 * A15x4 A7x4
 *
 * It is only a demo for hisilicon hi3630 board. You show change the
 * address of each node according to datasheet.
 */

/include/ "CHERRY_PLUS_R2_TL00M_VB_config.dtsi"
/include/ "CHERRY_PLUS_R2_TL00M_VC_pin.dtsi"
/include/ "CHERRY_PLUS_R2_TL00M_VC_gpio_logic.dtsi"
/include/ "CHERRY_PLUS_R2_TL00M_VC_pmic.dtsi"
/include/ "CHERRY_PLUS_R2_TL00M_VC_charger.dtsi"
/ {
    hisi,boardid = <0 7 5 0>;
    hisi,boardname = "CHERRY_PLUS_R2_TL00M_VC";
    hisi,modem_id = <0x3DD52100>;
};

