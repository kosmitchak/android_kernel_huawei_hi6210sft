/*
 *  Copyright (C) 2013 Huawei co Ltd.
 *
 *  This program is free software; you can redistribute it and/or modify
 *  it under the terms of the GNU General Public License version 2 as
 *  publishhed by the Free Software Foundation.
 */

/ {
    gps_power:gps_power{
        compatible = "huawei,gps_power";
        /*bcm's gps_en use name "gpio_hi1101_pwron" : gpio 4_0*/
        huawei,gps_en = <&gpio_hi1101_pwron>;
        clocks = <&CK32C>, <&clk_ssi_pad>, <&clk_ssi_pad_sel>;
        clock-names = "gps_32k", "ref_clk", "ref_clk_sel";
        pinctrl-names = "default", "idle";
        pinctrl-0 = <&GPIO_8_2_pmx_func>;
        pinctrl-1 = <&GPIO_8_2_pmx_idle>;
        /*broadcom configuration file use*/
        broadcom_config,gps_en = <32>;
    };
};
