/*
 *  Copyright (C) 2013 Huawei co Ltd.
 *
 *  This program is free software; you can redistribute it and/or modify
 *  it under the terms of the GNU General Public License version 2 as
 *  publishhed by the Free Software Foundation.
 */

/ {
   bcm_wifi {
			compatible = "hisilicon,bcm_wifi";
			/*
			clocks = <&clk_pmu32kb>;
			clock-names = "apb_pclk";
			pinctrl-names = "default", "idle";
			pinctrl-0 = <&gpio160_cfg_func &gpio212_cfg_func >;
			pinctrl-1 = <&gpio160_cfg_idle &gpio212_cfg_idle>;
			*/

		pinctrl-names = "default", "idle";
		pinctrl-0 = <&SDIO_CLK_cfg_func
			         &SDIO_CMD_cfg_func
			         &SDIO_DATA0_cfg_func
			         &SDIO_DATA1_cfg_func
			         &SDIO_DATA2_cfg_func
			         &SDIO_DATA3_cfg_func
				 &SDIO_CLK_pmx_func
			         &SDIO_CMD_pmx_func
			         &SDIO_DATA0_pmx_func
			         &SDIO_DATA1_pmx_func
			         &SDIO_DATA2_pmx_func
			         &SDIO_DATA3_pmx_func>;
		pinctrl-1 = <&SDIO_CLK_cfg_idle
			         &SDIO_CMD_cfg_idle
			         &SDIO_DATA0_cfg_idle
			         &SDIO_DATA1_cfg_idle
			         &SDIO_DATA2_cfg_idle
			         &SDIO_DATA3_cfg_idle
				 &SDIO_CLK_pmx_idle
			         &SDIO_CMD_pmx_idle
			         &SDIO_DATA0_pmx_idle
			         &SDIO_DATA1_pmx_idle
			         &SDIO_DATA2_pmx_idle
			         &SDIO_DATA3_pmx_idle>;

			wlan-on,gpio-enable= <&gpio_wl_en>;
			wlan-irq,gpio-irq = <&gpio_wl_wakeup_ap>;
			/*
			wifi_nvram_name = "/vendor/firmware/nvram4334_hw.txt";
			wifi_fw_name = "fw_bcm4343_hw.bin";
			*/
			wifi_fw_name= "/vendor/firmware/fw_bcm4343s_hw.bin";
			wifi_fw_ap_name = "/vendor/firmware/fw_bcm4343s_apsta_hw.bin";
			wifi_fw_p2p_name = "/vendor/firmware/fw_bcm4343s_p2p_hw.bin";
			wifi_fw_test_name = "/vendor/firmware/fw_bcm4343s_test_hw_apsta.bin";
	};
};
