/*
 *  Copyright (C) 2013 Huawei co Ltd.
 *
 *  This program is free software; you can redistribute it and/or modify
 *  it under the terms of the GNU General Public License version 2 as
 *  publishhed by the Free Software Foundation.
 */

/ {
    bluetooth_power:bluetooth_power{
        compatible = "huawei,bluetooth_power";
        huawei,bt_en = <&gpio_bt_p_en_sft>;
        huawei,ck32b = "CK32B";
        /*pinctrl-names = "default", "idle";
        pinctrl-0 = <&GPIO_4_3_cfg_func
                    &GPIO_1_3_cfg_func
                    &GPIO_3_7_cfg_func>;
        pinctrl-1 = <&GPIO_4_3_cfg_idle
                    &GPIO_1_3_cfg_idle
                    &GPIO_3_7_cfg_idle>;*/
        status = "ok";
    };

	bluetooth_sleep:bluetooth_sleep{
        compatible = "huawei,bluetooth_sleep";
        huawei,bt_wake_host = <&gpio_bt_wake_ap_sft>;
        huawei,host_wake_bt = <&gpio_ap_wake_bt_sft>;
        status = "ok";
    };
};
